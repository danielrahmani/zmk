/*
 * Copyright (c) 2020 Pete Johanson
 *
 * SPDX-License-Identifier: MIT
 */

#include "corne.dtsi"

&default_transform {
    col-offset = <6>;
};


&kscan0 {
    row-gpios
        = <&gpio0 02 (GPIO_ACTIVE_HIGH | GPIO_PULL_DOWN)>
        , <&gpio1 15 (GPIO_ACTIVE_HIGH | GPIO_PULL_DOWN)>
        , <&gpio1 13 (GPIO_ACTIVE_HIGH | GPIO_PULL_DOWN)>
        , <&gpio1 11 (GPIO_ACTIVE_HIGH | GPIO_PULL_DOWN)>
        ;


    col-gpios
            = <&gpio0 11 (GPIO_ACTIVE_HIGH| GPIO_PULL_DOWN)>
            , <&gpio1 0 (GPIO_ACTIVE_HIGH| GPIO_PULL_DOWN)>
            , <&gpio0 24 (GPIO_ACTIVE_HIGH| GPIO_PULL_DOWN)>
            , <&gpio0 22 (GPIO_ACTIVE_HIGH| GPIO_PULL_DOWN)>
            , <&gpio0 20 (GPIO_ACTIVE_HIGH| GPIO_PULL_DOWN)>
            , <&gpio0 17 (GPIO_ACTIVE_HIGH| GPIO_PULL_DOWN)>
            ;
};